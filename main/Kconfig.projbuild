## main/Kconfig.projbuild
```kconfig
menu "MCUNet VWW settings"

config MCUNET_TENSOR_ARENA_SIZE_KB
    int "Tensor arena size (KB)"
    range 256 4096
    default 512
    help
        TFLite Micro uses this arena for activations and persistent runtime data.

config MCUNET_ARENA_IN_PSRAM
    bool "Place the tensor arena in external PSRAM"
    default y
    help
        PSRAM is the reliable default for N16R8 modules. Internal SRAM is faster,
        but a large contiguous allocation may not be available after startup.

config MCUNET_STATUS_LED_GPIO
    int "Addressable RGB status LED GPIO"
    range 0 48
    default 48
    help
        GPIO connected to the board's WS2812-compatible RGB LED.

endmenu
```

## sdkconfig.defaults
```kconfig
CONFIG_ESP_DEFAULT_CPU_FREQ_MHZ_240=y
CONFIG_ESPTOOLPY_FLASHSIZE_16MB=y
CONFIG_PARTITION_TABLE_CUSTOM=y
CONFIG_PARTITION_TABLE_CUSTOM_FILENAME="partitions.csv"
CONFIG_COMPILER_OPTIMIZATION_PERF=y

# ESP32-S3-WROOM N16R8 uses 8 MB octal PSRAM.
CONFIG_SPIRAM=y
CONFIG_SPIRAM_MODE_OCT=y
CONFIG_SPIRAM_SPEED_80M=y
CONFIG_SPIRAM_USE_CAPS_ALLOC=y

CONFIG_MCUNET_ARENA_IN_PSRAM=y
CONFIG_MCUNET_TENSOR_ARENA_SIZE_KB=512
```
